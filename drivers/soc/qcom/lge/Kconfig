## drivers/soc/qcom/lge/Kconfig
```kconfig
config MACH_LGE
	bool "Machine LGE"
	help
	  Support for machine LGE.

menu "LGE Board Selection"

config MACH_MSM8937_PH2N_GSM_US
	bool "MSM8937 PH2N_GSM_US"
	depends on ARCH_MSM8916
	select MACH_LGE
	help
	  Support for the Qualcomm MSM8937 PH2N_GSM_US devices (TMO/MPCS).

config MACH_MSM8917_LV517_GSM_US
	bool "MSM8917 LV517_GSM_US"
	depends on ARCH_MSM8916
	select MACH_LGE
	help
	  Support for the Qualcomm MSM8917 LV517_GSM_US devices (TMO/MPCS).

config MACH_MSM8940_SF3_TMO_US
	bool "MSM8940 SF3_TMO_US"
	depends on ARCH_MSM8916
	select MACH_LGE
	help
	  Support for the Qualcomm MSM8940 SF3_TMO_US device.

endmenu

menu "LGE Specific Patches"

config LGE_HANDLE_PANIC
	tristate "Support LGE Crash Handler"
	default n
	depends on MACH_LGE
	help
	  LGE Crash Handler

config LGE_QSDL_SUPPORT
	tristate "Support for Quality Statistics Data Logging"
	default n
	depends on MACH_LGE
	help
	  QSDL is a feature which notify infomation for quality statistics data logging of device.
	  
config LGE_BOOTLOADER_LOG
	tristate "Support LGE bootloader log"
	default n
	depends on MACH_LGE
	help
	  LGE bootloader log

config LGE_BOOTLOADER_TIME_CHECKER
	tristate "Supprt bootloader(LK, SBL) time"
	default n
	depends on MACH_LGE
	help
	  Check LK, SBL booting time at
	  sys/module/lge_bootloader_time_checker/parameters/lk_time
	  sys/module/lge_bootloader_time_checker/parameters/sbl_time

config LGE_PM
	tristate "Support LGE power-management"
	default n
	depends on MACH_LGE
	help
	  Global feature of LGE power-management

config LGE_PM_DEBUG
        tristate "Support LGE PM Debug Feature"
        default n
        depends on MACH_LGE
        help
	  LGE PM Debug Feature

config LGE_PM_PSEUDO_BATTERY
	tristate "Support pseudo battery mode"
	depends on MACH_LGE
	default n
	help
	  Say Y here to enable pseudo mode setting

config LGE_PM_CHARGING_TEMP_SCENARIO
tristate "Support LGE PM Charging scenario"
	default n
	depends on MACH_LGE
	help
	  LGE PM Charing Scenario

config LGE_UART_CONTROL
	tristate "Support LGE uart control"
	default n
	depends on MACH_LGE && SERIAL_MSM_HSL
	help
	  This module controls uart console.

config LGE_EARJACK_DEBUGGER
	tristate "Earjack UART debugger support"
	default n
	depends on LGE_UART_CONTROL
	help
	  Support earjack type UART debugger cable

config LGE_PM_CABLE_DETECTION
    tristate "Support LGE PM Cable Detection"
	default n
	depends on MACH_LGE
	help
	  LGE PM Cable Detection

config LGE_PM_UNIFIED_NODE
	bool "enable LGE PM Unified sysfs node"
	default n
	depends on MACH_LGE
	help
	  Support LGE PM Unified sysfs node

config LGE_PM_ONBINARY_ORANGE
        tristate "Support LGE PM Onebinary orange Detection"
	default n
	depends on LGE_PM
	help
	  LGE PM Onebinary Orange Detection

config PRE_SELF_DIAGNOSIS
	tristate "Support LGE self diagnosis for factory"
	default n
	depends on MACH_LGE
	help
	  LGE self diagnosis
endmenu

menu "LGE QFPROM Values"

config LGE_QFPROM_INTERFACE
	bool "Support qfprom interface"
	default n
	depends on MACH_LGE
	help
	  LGE QFPROM DRIVER.

config LGE_QFPROM_SECHASH
	string "Support qfprom sec hash"
	default 0x0
	depends on LGE_QFPROM_INTERFACE
	help
	  LGE QFPROM DRIVER-SEC partition's hash value.
endmenu
```
